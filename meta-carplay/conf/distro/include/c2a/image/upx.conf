## meta-carplay/conf/distro/include/c2a/image/upx.conf
```bitbake
IMAGE_UPX_TARGETS += "/usr/sbin/dropbearmulti"
IMAGE_UPX_TARGETS += "/usr/libexec/sftp-server"
#IMAGE_UPX_TARGETS += "/usr/libexec/bluetooth/bluetoothd"
#IMAGE_UPX_TARGETS += "/usr/sbin/hostapd"
#IMAGE_UPX_TARGETS += "/usr/sbin/wpa_supplicant"
IMAGE_UPX_TARGETS += "/usr/bin/bluetoothctl"
```

## meta-carplay/conf/distro/include/c2a/image/wic.conf
```bitbake
C2A_WICVARS += "UBOOT_BINARY KERNEL_FIT_LINK_NAME KERNEL_ARTIFACT_LINK_NAME"
C2A_WICVARS += "C2A_FLASH_SIZE C2A_UBOOT_SPL_OFFSET C2A_UBOOT_SPL_SIZE C2A_UBOOT_OFFSET C2A_UBOOT_SIZE"
C2A_WICVARS += "C2A_KERNEL_OFFSET C2A_KERNEL_SIZE C2A_ROOTFS_OFFSET C2A_ROOTFS_SIZE"
C2A_WICVARS += "C2A_WIC_UBOOT_PATH C2A_WIC_KERNEL_PATH C2A_WIC_ROOTFS_PATH"
```

## meta-carplay/conf/distro/include/c2a/lto-thin.conf
```bitbake
### BLACKLIST: no .o-based thin-lto

BUILD_OPTIMIZATION:pn-zlib:forcevariable = "-Oz"
SELECTED_OPTIMIZATION:pn-zlib:forcevariable = "-Oz"

BUILD_OPTIMIZATION:pn-ncurses:forcevariable = "-Os"
SELECTED_OPTIMIZATION:pn-ncurses:forcevariable = "-Os"

BUILD_OPTIMIZATION:pn-ttyrun:forcevariable = "-Oz"
SELECTED_OPTIMIZATION:pn-ttyrun:forcevariable = "-Oz"

BUILD_OPTIMIZATION:pn-libxcrypt:forcevariable = "-Oz"
SELECTED_OPTIMIZATION:pn-libxcrypt:forcevariable = "-Oz"

BUILD_OPTIMIZATION:pn-libtircp:forcevariable = "-Oz"
SELECTED_OPTIMIZATION:pn-libtirpc:forcevariable = "-Oz"

BUILD_OPTIMIZATION:pn-sysvinit:forcevariable = "-Oz"
SELECTED_OPTIMIZATION:pn-sysvinit:forcevariable = "-Oz"

BUILD_OPTIMIZATION:pn-busybox:forcevariable = "-Oz"
SELECTED_OPTIMIZATION:pn-busybox:forcevariable = "-Oz"

BUILD_OPTIMIZATION:pn-perl:forcevariable = "-Oz"
SELECTED_OPTIMIZATION:pn-perl:forcevariable = "-Oz"

BUILD_OPTIMIZATION:pn-bash:forcevariable = "-Os"
SELECTED_OPTIMIZATION:pn-bash:forcevariable = "-Os"

BUILD_OPTIMIZATION:pn-python3:forcevariable = "-Oz"
SELECTED_OPTIMIZATION:pn-python3:forcevariable = "-Oz"

BUILD_OPTIMIZATION:pn-alsa-lib:forcevariable = "-Oz"
SELECTED_OPTIMIZATION:pn-alsa-lib:forcevariable = "-Oz"

BUILD_OPTIMIZATION:pn-libcap:forcevariable = "-Os"
SELECTED_OPTIMIZATION:pn-lipcap:forcevariable = "-Os"

BUILD_OPTIMIZATION:pn-iptables:forcevariable = "-Oz"
SELECTED_OPTIMIZATION:pn-iptables:forcevariable = "-Oz"

BUILD_OPTIMIZATION:pn-readline:forcevariable = "-Oz"
SELECTED_OPTIMIZATION:pn-readline:forcevariable = "-Oz"

BUILD_OPTIMIZATION:pn-glib-2.0:forcevariable = "-Oz"
SELECTED_OPTIMIZATION:pn-glib-2.0:forcevariable = "-Oz"

BUILD_OPTIMIZATION:pn-wpa-supplicant:forcevariable = "-Oz"
SELECTED_OPTIMIZATION:pn-wpa-supplicant:forcevariable = "-Oz"

BUILD_OPTIMIZATION:pn-iw:forcevariable = "-Oz"
SELECTED_OPTIMIZATION:pn-iw:forcevariable = "-Oz"

BUILD_OPTIMIZATION:pn-dropbear:forcevariable = "-Oz"
SELECTED_OPTIMIZATION:pn-dropbear:forcevariable = "-Oz"

BUILD_OPTIMIZATION:pn-shared-mime-info:forcevariable = "-Oz"
SELECTED_OPTIMIZATION:pn-shared-mime-info:forcevariable = "-Oz"

BUILD_OPTIMIZATION:pn-bluez5:forcevariable = "-Oz"
SELECTED_OPTIMIZATION:pn-bluez5:forcevariable = "-Oz"

BUILD_OPTIMIZATION:pn-iproute2:forcevariable = "-Oz"
SELECTED_OPTIMIZATION:pn-iproute2:forcevariable = "-Oz"

BUILD_OPTIMIZATION:pn-make-mod-scripts:forcevariable = "-Os"
SELECTED_OPTIMIZATION:pn-make-mod-scripts:forcevariable = "-Os"
```

## meta-carplay/conf/layer.conf
```bitbake
BBPATH .= ":${LAYERDIR}"
BBFILES += "\
  ${LAYERDIR}/recipes-*/*.bb \
  ${LAYERDIR}/recipes-*/*/*.bb \
  ${LAYERDIR}/recipes-*/*.bbappend \
  ${LAYERDIR}/recipes-*/*/*.bbappend \
"
LICENSE_PATH += "${LAYERDIR}/licenses"

BBFILE_COLLECTIONS += "carplay"
BBFILE_PATTERN_carplay = "^${LAYERDIR}/"
BBFILE_PRIORITY_carplay = "6"

LAYERSERIES_COMPAT_carplay = "scarthgap"
```

## meta-sunxi/conf/layer.conf
```bitbake
BBPATH .= ":${LAYERDIR}"
BBFILES += "\
  ${LAYERDIR}/recipes-*/*.bb \
  ${LAYERDIR}/recipes-*/*/*.bb \
  ${LAYERDIR}/recipes-*/*.bbappend \
  ${LAYERDIR}/recipes-*/*/*.bbappend \
"

BBFILE_COLLECTIONS += "sunxi"
BBFILE_PATTERN_sunxi = "^${LAYERDIR}/"
BBFILE_PRIORITY_sunxi = "7"

LAYERSERIES_COMPAT_sunxi = "scarthgap wrynose"
```

## meta-sunxi/conf/machine/include/v821/flash-nor.conf
```bitbake
# Flash layout
# Needs to be in sync with: .dts AND brandy-2.0 patches
C2A_FLASH_SIZE = "16M" 

FLASH_BOOT0_BIN = "${DEPLOY_DIR_IMAGE}/sunxi-brandy/simpleboot-v821b-falcon2.bin"
FLASH_KERNEL_BIN = "${DEPLOY_DIR_IMAGE}/c2rvImage"
FLASH_INITRD_BIN = "${DEPLOY_DIR_IMAGE}/${C2A_INITRAMFS_IMAGE}-${MACHINE}.erofs-lz4hc"
FLASH_PERSIST_BIN = "${IMGDEPLOYDIR}/${IMAGE_LINK_NAME}.${C2A_ROOTFS_FSTYPE}"

# boot0 256KB
# kernel 4MB
# initrd ~11MB
# persist ~0.75MB

C2A_FLASH_PARTITIONS = "\
    ${FLASH_BOOT0_BIN} 0x00000000 0x00040000 \
    ${FLASH_KERNEL_BIN} 0x00040000 0x00400000 \
    ${FLASH_INITRD_BIN} 0x00440000 0x00b00000 \
    ${FLASH_PERSIST_BIN} 0x00f40000 0x000C0000 \
"
```

## meta-sunxi/conf/machine/include/v821/recovery.conf
```bitbake
C2A_KERNEL_EXTRA_CONFIG[CONFIG_CMDLINE] = ""
C2A_KERNEL_EXTRA_CONFIG[CONFIG_CMDLINE_OVERRIDE] = "n"
C2A_KERNEL_EXTRA_CONFIG[CONFIG_BLK_DEV_RAM] = "y"
C2A_KERNEL_EXTRA_CONFIG[CONFIG_BLK_DEV_INITRD] = "y"
C2A_KERNEL_EXTRA_CONFIG[CONFIG_BLK_DEV_RAM_COUNT] = "16"
C2A_KERNEL_EXTRA_CONFIG[CONFIG_BLK_DEV_RAM_SIZE] = "16384"

C2A_KERNEL_EXTRA_CONFIG[CONFIG_EARLY_PRINTK] = "y"
C2A_KERNEL_EXTRA_CONFIG[CONFIG_EARLY_PRINTK_8250] = "y"
C2A_KERNEL_EXTRA_CONFIG[CONFIG_EARLY_CONSOLE] = "y"
C2A_KERNEL_EXTRA_CONFIG[CONFIG_USE_GENERIC_EARLY_PRINTK_8250] = "y"
```

## meta-sunxi/conf/machine/include/v821/shared.conf
```bitbake
DEFAULTTUNE = "riscv32"
MACHINEOVERRIDES =. "woo:v821:"

MACHINE_FEATURES += "wifi bluetooth"

LDFLAGS:append:pn-dropbear:mipsarch = " -static"
PREFERRED_PROVIDER_virtual/bootloader = "sunxi-brandy"

# Or aic8800-fw-aic8800d80 aic8800
MACHINE_FIRMWARE:append = " carlinkit-otalib carlinkit-init carlinkit-mini-nvram c2a-firmware-rtl8733bs"
CATPLAY_DEBUG_BUILD ?= "0"

DISTRO = "c2a-musl"
JFFS2_ERASEBLOCK = "0x1000"

C2A_SYSTEM_PACKAGES:remove = "wpa-supplicant"

require conf/machine/include/riscv/tune-riscv.inc

include conf/machine/include/v821/kernel.conf
include conf/machine/include/v821/wic.conf

# UPX not compatible with riscv32
IMAGE_UPX_TARGETS:forcevariable = ""
```

## meta-sunxi/conf/machine/v821b-rtl8733bs-recov.conf
```bitbake
require conf/machine/include/v821/shared.conf
require conf/machine/include/v821/flash-nor.conf
require conf/machine/include/v821/recovery.conf

require conf/system/include/c2a/machine-boot/c2rv-erofs.conf

# catplay-bench i2c-tools
MACHINE_FIRMWARE:append = " devmem2 "
C2A_FLASH_PARTITIONS = ""
C2A_BUNDLE_NAME = "v821b-rtl8733bs"
C2A_BUNDLE_EXTRA_DEPENDS:append = " sunxi-flasher:do_deploy"
C2A_BUNDLE_EXTRA_DEPENDS:append = " virtual/dtb:do_deploy"
C2A_BUNDLE_EXTRA_DEPENDS:append = " sunxi-brandy:do_deploy"
C2A_BUNDLE_EXTRA_DEPENDS:append = " virtual/opensbi:do_deploy"

C2A_BUNDLE_ARTIFACTS:append = " \
 ${DEPLOY_DIR_IMAGE}/tools/flash.py,tools/flash.py,1 \
 ${DEPLOY_DIR_IMAGE}/tools/recov.py,tools/recov.py,1 \
 ${DEPLOY_DIR_IMAGE}/tools/uploader.py,tools/uploader.py,1 \
 ${DEPLOY_DIR_IMAGE}/tools/cpbox_client.py,tools/cpbox_client.py,1 \
 ${DEPLOY_DIR_IMAGE}/tools/cpbox2fel.py,tools/cpbox2fel.py,1 \
 ${DEPLOY_DIR_IMAGE}/tools/wizard.py,tools/wizard.py,1 \
 ${DEPLOY_DIR_IMAGE}/tools/reboot2recovery.py,tools/reboot2recovery.py,1 \
 ${DEPLOY_DIR_IMAGE}/devicetree/woo.dtb,woo.dtb,1 \
 ${DEPLOY_DIR_IMAGE}/sunxi-opensbi/opensbi-v821.bin,opensbi.bin,1 \
 ${DEPLOY_DIR_IMAGE}/sunxi-brandy/simpleboot-v821b-falcon.bin,simpleboot.bin,1 \
 ${DEPLOY_DIR_IMAGE}/sunxi-brandy/fes1-sun300iw1p1-v821b.bin,fes1.bin,1 \
"
```

## meta-sunxi/conf/machine/v821b-rtl8733bs.conf
```bitbake
require conf/machine/include/v821/shared.conf
require conf/machine/include/v821/flash-nor.conf

require conf/system/include/c2a/machine-boot/c2rv-erofs.conf
#require conf/system/include/c2a/machine-boot/initramfs.conf

# catplay-bench
MACHINE_FIRMWARE:append = " catplay-g-iphone catplay "
```
