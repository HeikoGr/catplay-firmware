## meta-carlinkit-mini/conf/layer.conf
```bitbake
BBPATH .= ":${LAYERDIR}"
BBFILES += "\
  ${LAYERDIR}/recipes-*/*.bb \
  ${LAYERDIR}/recipes-*/*/*.bb \
  ${LAYERDIR}/recipes-*/*.bbappend \
  ${LAYERDIR}/recipes-*/*/*.bbappend \
"

BBFILE_COLLECTIONS += "carlinkit-mini"
BBFILE_PATTERN_carlinkit-mini = "^${LAYERDIR}/"
BBFILE_PRIORITY_carlinkit-mini = "7"

LAYERSERIES_COMPAT_carlinkit-mini = "scarthgap"
```

## meta-carlinkit-mini/conf/machine/clk-mini-ultra-nor.conf
```bitbake
require conf/machine/include/clk-mini-ultra/shared.conf
require conf/machine/include/clk-mini-ultra/flash-nor.conf

require conf/system/include/c2a/machine-boot/erofs-base.conf
#require conf/system/include/c2a/machine-boot/initramfs.conf

# catplay-bench
MACHINE_FIRMWARE:append = " catplay-g-iphone catplay "
```

## meta-carlinkit-mini/conf/machine/include/clk-mini-ultra/shared.conf
```bitbake
DEFAULTTUNE = "mips32r2el"
MACHINEOVERRIDES =. "clk-mini-ultra:ingenic-x1600:"
PACKAGE_EXTRA_ARCHS:append = " ingenic-x1600"

MACHINE_FEATURES += "wifi bluetooth"

LDFLAGS:append:pn-dropbear:mipsarch = " -static"
PREFERRED_PROVIDER_virtual/bootloader = "u-boot-letux"

MACHINE_FIRMWARE:append = " carlinkit-otalib aic8800 carlinkit-init carlinkit-mini-nvram aic8800-fw-aic8800d80"
CATPLAY_DEBUG_BUILD ?= "0"

DISTRO = "c2a-musl"
JFFS2_ERASEBLOCK = "0x1000"

#C2A_SYSTEM_PACKAGES:remove = "wpa-supplicant"

include conf/machine/include/mips/tune-mips32r2.inc
include conf/machine/include/clk-mini-ultra/kernel.conf
include conf/machine/include/clk-mini-ultra/wic.conf
```

## meta-carlinkit/conf/layer.conf
```bitbake
BBPATH .= ":${LAYERDIR}"
BBFILES += "\
  ${LAYERDIR}/recipes-*/*.bb \
  ${LAYERDIR}/recipes-*/*/*.bb \
  ${LAYERDIR}/recipes-*/*.bbappend \
  ${LAYERDIR}/recipes-*/*/*.bbappend \
"

BBFILE_COLLECTIONS += "carlinkit"
BBFILE_PATTERN_carlinkit = "^${LAYERDIR}/"
BBFILE_PRIORITY_carlinkit = "7"

LAYERSERIES_COMPAT_carlinkit = "scarthgap"
```

## meta-carlinkit/conf/machine/imx6ul-c2a-bcm4358.conf
```bitbake
require conf/machine/include/imx6ul-c2a/machine-shared.conf
require conf/system/include/c2a/machine-boot/fit-erofs.conf

MACHINE_FIRMWARE:append = " c2a-firmware-bcmdhd-bcm4358"
```

## meta-carlinkit/conf/machine/imx6ul-c2a-rtl8822cs.conf
```bitbake
require conf/machine/include/imx6ul-c2a/machine-shared.conf
require conf/machine/include/imx6ul-c2a/realtek-shared.conf
require conf/system/include/c2a/machine-boot/fit-erofs.conf

MACHINE_FIRMWARE:append = " c2a-firmware-rtl8822cs"
```

## meta-carlinkit/conf/machine/include/imx6ul-c2a/kernel.conf
```bitbake
# Kernel
TARGET_CC_KERNEL_ARCH = "-mfloat-abi=hard -mfpu=vfpv3-d16"
PREFERRED_PROVIDER_virtual/kernel = "linux-fslc"
PREFERRED_PROVIDER_virtual/dtb = "carlinkit-dtb"
C2A_APPEND:prepend = "quiet "
```

## meta-carlinkit/conf/machine/include/imx6ul-c2a/machine-shared.conf
```bitbake
MACHINEOVERRIDES =. "imx6ul-c2a:mx6ul:"
DISTRO = "c2a-musl"
CATPLAY_DEBUG_BUILD ?= "0"
JFFS2_ERASEBLOCK = "0x10000"

include conf/machine/include/imx-base.inc
include conf/machine/include/arm/armv7a/tune-cortexa7.inc

MACHINE_FEATURES += "wifi bluetooth"
MACHINE_FIRMWARE:remove = "linux-firmware-imx-sdma-imx7d firmware-imx-vpu-imx6q firmware-imx-vpu-imx6d"
MACHINE_FIRMWARE:append = " carlinkit-nvram carlinkit-rgb carlinkit-init carlinkit-otalib catplay"
#MACHINE_FIRMWARE:append = " tcpdump"

# That's a legacy driver that also doesn't compile with mainline
# MACHINE_EXTRA_RRECOMMENDS:remove = "kernel-module-nxp-wlan"
include conf/machine/include/imx6ul-c2a/flash.conf
include conf/machine/include/imx6ul-c2a/kernel.conf
include conf/machine/include/imx6ul-c2a/uboot.conf
include conf/machine/include/imx6ul-c2a/wic.conf
```

## meta-carlinkit/conf/machine/include/imx6ul-c2a/uboot.conf
```bitbake
# U-Boot IMX build config
SPL_BINARY:pn-u-boot-imx = ""
UBOOT_MAKE_TARGET:pn-u-boot-imx = "u-boot.imx"
#UBOOT_SUFFIX:pn-u-boot-imx = "imx"
UBOOT_SUFFIX:pn-u-boot-imx = "bin"

# U-Boot
PREFERRED_PROVIDER_u-boot = "u-boot-imx"
IMX_DEFAULT_BOOTLOADER = "u-boot-imx"
UBOOT_CONFIG = "imx6ul-c2a"
UBOOT_CONFIG[imx6ul-c2a] = "imx6ul-c2a_defconfig"
```

## meta-carlinkit/conf/machine/include/imx6ul-c2a/wic.conf
```bitbake
WKS_FILES = "c2a-imx-carlinkit.wks.in"
C2A_SUPPORTS_WIC ?= "1"

C2A_WICVARS += " CARLINKIT_WIC_UBOOT_PATH CARLINKIT_WIC_CSF_PATH"
C2A_WICVARS +=  " CARLINKIT_UBOOT_OFFSET CARLINKIT_UBOOT_SIZE"
```

## meta-carlinkit/recipes-bsp/u-boot/files/board/freescale/mx6ul_c2a/Kconfig
```kconfig
if TARGET_MX6UL_C2A

config SYS_BOARD
	default "mx6ul_c2a"

config SYS_VENDOR
	default "freescale"

config SYS_CONFIG_NAME
	default "mx6ul_c2a"

config TEXT_BASE
	default 0x87800000
endif
```

## meta-carplay/conf/distro/c2a-musl.conf
```bitbake
DISTRO = "c2a-musl"

require conf/distro/include/c2a/distro-base.conf
require conf/distro/include/c2a/musl.conf
```

## meta-carplay/conf/distro/c2a.conf
```bitbake
DISTRO = "c2a"
TCLIBC = "glibc"

require conf/distro/include/c2a/distro-base.conf
```

## meta-carplay/conf/distro/include/c2a/distro-base.conf
```bitbake
require conf/distro/include/lto.inc
require conf/distro/include/c2a/gcsections.conf

require conf/distro/include/c2a/common.conf
require conf/distro/include/c2a/busybox.conf
require conf/distro/include/c2a/clang.conf
require conf/distro/include/c2a/lto.conf
require conf/distro/include/c2a/rust.conf

require conf/distro/include/c2a/image/cleanup.conf
require conf/distro/include/c2a/image/dtc.conf
require conf/distro/include/c2a/image/firmware-conflicts.conf
require conf/distro/include/c2a/image/jffs2.conf
require conf/distro/include/c2a/image/upx.conf
require conf/distro/include/c2a/image/wic.conf
```

## meta-carplay/conf/distro/include/c2a/image/cleanup.conf
```bitbake
IMAGE_CLEANUP_TARGETS += "\
    /usr/bin/isotest \
    /usr/bin/rctest \
    /usr/bin/mpris-proxy \
    /usr/bin/l2test \
    /usr/bin/rfcomm \
    /usr/bin/l2ping \
    /usr/bin/btmon \
    /usr/bin/bluemoon \
    /usr/bin/btattach \
    /usr/bin/dbus-monitor \
    /usr/bin/dbus-send \
    /usr/bin/dbus-launch \
    /usr/bin/dbus-run-session \
    /usr/bin/dbus-update-activation-environment \
    /usr/bin/hex2hcd \
    /lib/firmware/LICENSE.* \
"

IMAGE_CLEANUP_TARGETS += "\
    /sbin/sulogin /sbin/sulogin.util-linux \
    /usr/bin/newgrp /usr/bin/newgrp.shadow \
    /usr/bin/groups /usr/bin/groups.shadow \
    /bin/su /bin/su.shadow /bin/login.shadow \
"
```

## meta-carplay/conf/distro/include/c2a/image/dtc.conf
```bitbake
C2A_BOOTARGS ?= "${C2A_APPEND}"
C2A_APPEND ??= ""

C2A_DTC_STRINGS += "C2A_APPEND C2A_BOOTARGS"
C2A_DTC_INTS += "C2A_UBOOT_OFFSET_HEX C2A_UBOOT_SIZE_HEX"
C2A_DTC_INTS += "C2A_UBOOT_SPL_OFFSET_HEX C2A_UBOOT_SPL_SIZE_HEX"
C2A_DTC_INTS += "C2A_KERNEL_OFFSET_HEX C2A_KERNEL_SIZE_HEX"
C2A_DTC_INTS += "C2A_ROOTFS_OFFSET_HEX C2A_ROOTFS_SIZE_HEX"
C2A_DTC_INTS += "C2A_FLASH_SIZE_HEX"

C2A_OFFSET_HELPER_VARS += "C2A_FLASH_SIZE C2A_UBOOT_OFFSET C2A_UBOOT_SIZE C2A_UBOOT_SPL_OFFSET C2A_UBOOT_SPL_SIZE C2A_KERNEL_OFFSET C2A_KERNEL_SIZE C2A_ROOTFS_OFFSET C2A_ROOTFS_SIZE"
```

## meta-carplay/conf/distro/include/c2a/image/firmware-conflicts.conf
```bitbake
C2A_FIRMWARE_CONFLICTS ?= "kernel-module-rtw88* kernel-module-brcmfmac* kernel-module-brcmutil* kernel-module-mwifiex* "
PACKAGE_EXCLUDE:append = " linux-firmware-rtl8822 udev udev-hwdb eudev"
```
